/*
 * Copyright (c) 2015-2017, The Linux Foundation. All rights reserved.
 * SPDX-License-Identifier: GPL-2.0-only
 */

/dts-v1/;
 
#include "msm8953-qrd-sku3-tissot-common.dtsi"

&firmware {
	android {
		fstab {
			vendor {
				fsmgr_flags = "wait,slotselect";
				status = "ok";
			};
		};
	};
};
